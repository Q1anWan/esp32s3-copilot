## sdkconfig.defaults
```kconfig
CONFIG_IDF_TARGET="esp32s3"
CONFIG_ESPTOOLPY_FLASHMODE_QIO=y
CONFIG_ESPTOOLPY_FLASHSIZE_16MB=y
CONFIG_PARTITION_TABLE_CUSTOM=y
CONFIG_COMPILER_OPTIMIZATION_PERF=y
CONFIG_SPIRAM=y
CONFIG_SPIRAM_MODE_OCT=y
CONFIG_SPIRAM_FETCH_INSTRUCTIONS=y
CONFIG_SPIRAM_RODATA=y
CONFIG_SPIRAM_SPEED_80M=y
CONFIG_SPIRAM_MALLOC_ALWAYSINTERNAL=1024
CONFIG_SPIRAM_MALLOC_RESERVE_INTERNAL=65536
CONFIG_SPIRAM_TRY_ALLOCATE_WIFI_LWIP=y
CONFIG_ESP_WIFI_STATIC_RX_BUFFER_NUM=6
CONFIG_ESP_WIFI_DYNAMIC_RX_BUFFER_NUM=16
CONFIG_ESP_WIFI_STATIC_TX_BUFFER=y
CONFIG_ESP_WIFI_STATIC_TX_BUFFER_NUM=8
CONFIG_ESP_WIFI_CACHE_TX_BUFFER_NUM=8
CONFIG_ESP_WIFI_TX_BA_WIN=4
CONFIG_ESP_WIFI_RX_BA_WIN=6
CONFIG_ESP_WIFI_MGMT_SBUF_NUM=16
CONFIG_ESP_DEFAULT_CPU_FREQ_MHZ_240=y
CONFIG_ESP_SYSTEM_EVENT_TASK_STACK_SIZE=8192
CONFIG_ESP_CONSOLE_USB_SERIAL_JTAG=y
CONFIG_ESP_CONSOLE_SECONDARY_NONE=y
CONFIG_ESP_CONSOLE_UART_BAUDRATE=2000000
CONFIG_FREERTOS_HZ=1000
CONFIG_FATFS_LFN_HEAP=y
CONFIG_FATFS_SECTOR_512=y
# CONFIG_FATFS_ALLOC_PREFER_EXTRAM is not set
CONFIG_FATFS_VFS_FSTAT_BLKSIZE=4096
CONFIG_BSP_LCD_RGB_BUFFER_NUMS=2
# CONFIG_BSP_DISPLAY_TOUCH_ENABLE is not set
CONFIG_BSP_DISPLAY_LVGL_TASK_STACK_SIZE_KB=6
CONFIG_BSP_DISPLAY_LVGL_DIRECT_MODE=y
CONFIG_LV_COLOR_SCREEN_TRANSP=y
CONFIG_LV_MEM_CUSTOM=y
CONFIG_LV_MEMCPY_MEMSET_STD=y
CONFIG_LV_USE_PERF_MONITOR=y
CONFIG_LV_ATTRIBUTE_FAST_MEM_USE_IRAM=y
CONFIG_LV_FONT_MONTSERRAT_8=y
CONFIG_LV_FONT_MONTSERRAT_10=y
CONFIG_LV_FONT_MONTSERRAT_12=y
CONFIG_LV_FONT_MONTSERRAT_16=y
CONFIG_LV_FONT_MONTSERRAT_18=y
CONFIG_LV_FONT_MONTSERRAT_20=y
CONFIG_LV_FONT_MONTSERRAT_22=y
CONFIG_LV_FONT_MONTSERRAT_24=y
CONFIG_LV_FONT_MONTSERRAT_26=y
CONFIG_LV_FONT_MONTSERRAT_28=y
CONFIG_LV_FONT_MONTSERRAT_30=y
CONFIG_LV_FONT_MONTSERRAT_32=y
CONFIG_LV_FONT_MONTSERRAT_34=y
CONFIG_LV_FONT_MONTSERRAT_36=y
CONFIG_LV_FONT_MONTSERRAT_38=y
CONFIG_LV_FONT_MONTSERRAT_40=y
CONFIG_LV_FONT_MONTSERRAT_42=y
CONFIG_LV_FONT_MONTSERRAT_44=y
CONFIG_LV_FONT_MONTSERRAT_48=y
CONFIG_LV_FONT_FMT_TXT_LARGE=y
CONFIG_LV_USE_FONT_COMPRESSED=y
CONFIG_LV_USE_DEMO_BENCHMARK=y
CONFIG_CODEC_I2C_BACKWARD_COMPATIBLE=n
CONFIG_CODEC_ES8311_SUPPORT=y
# CONFIG_CODEC_ES7210_SUPPORT is not set
# CONFIG_CODEC_ES7243_SUPPORT is not set
# CONFIG_CODEC_ES7243E_SUPPORT is not set
# CONFIG_CODEC_ES8156_SUPPORT is not set
# CONFIG_CODEC_AW88298_SUPPORT is not set
# CONFIG_CODEC_ES8389_SUPPORT is not set
# CONFIG_CODEC_ES8374_SUPPORT is not set
# CONFIG_CODEC_ES8388_SUPPORT is not set
# CONFIG_CODEC_TAS5805M_SUPPORT is not set
# CONFIG_BSP_ES7210_MIC_ENABLE is not set
CONFIG_LV_COLOR_16_SWAP=y
CONFIG_COPILOT_SD_AUDIO_ENABLE=y
CONFIG_COPILOT_TCP_HOST_ENABLE=y
CONFIG_COPILOT_TCP_HOST_PORT=7777
# CONFIG_COPILOT_TCP_AUDIO_ID_ENABLE is not set
CONFIG_COPILOT_TCP_AUDIO_ID_NUMERIC_SCENE_PREFIX="scene"
CONFIG_COPILOT_TCP_AUDIO_ID_DEDUPE_MS=0
CONFIG_COPILOT_SERIAL_CONSOLE_ENABLE=y
CONFIG_COPILOT_MQTT_BROKER_URI=""
# CONFIG_COPILOT_VOICE_ENABLE is not set
CONFIG_COPILOT_UI_CORE=0
CONFIG_COPILOT_DISPLAY_ROTATE_180=y
CONFIG_COPILOT_ACTION_CORE=1
CONFIG_COPILOT_AUDIO_CORE=1
CONFIG_COPILOT_VOICE_TASK_CORE=1
CONFIG_COPILOT_SERVO_ENABLE=y
CONFIG_COPILOT_SERVO_PITCH_GPIO=17
CONFIG_COPILOT_SERVO_YAW_GPIO=18
CONFIG_COPILOT_SERVO_TASK_PRIORITY=10
CONFIG_COPILOT_SERVO_TASK_CORE=1
CONFIG_COPILOT_SERVO_PITCH_SCALE=100
CONFIG_COPILOT_SERVO_YAW_SCALE=100
CONFIG_BSP_LCD_RGB_BOUNCE_BUFFER_HEIGHT=30
CONFIG_LV_DEF_REFR_PERIOD=16
```
